/*
 * Copyright (c) 2020 The ZMK Contributors
 *
 * SPDX-License-Identifier: MIT
 */

#include <dt-bindings/zmk/behaviors.h>

/ {
    behaviors {
#if ZMK_BEHAVIOR_OMIT(SM)
        /omit-if-no-ref/
#endif
        sm: sticky_mods {
            compatible = "zmk,behavior-sticky-mods";
            #binding-cells = <2>;
            display-name = "Sticky Mods";
        };
    };
};